## drivers/entropy/Kconfig.s32_hse
```kconfig
menuconfig ENTROPY_NXP_S32K_HSE
	bool "S32K HSE TRNG driver"
	default y
	depends on DT_HAS_NXP_S32_HSE_TRNG_ENABLED
	select ENTROPY_HAS_DRIVER
	help
	  This option enables TRNG support via the S32K HSE.
```

## drivers/fuel_gauge/bq34z100/Kconfig
```kconfig
# Copyright (c) Qualcomm Technologies, Inc. and/or its subsidiaries.
#
# SPDX-License-Identifier: Apache-2.0

config BQ34Z100
	bool "BQ34Z100 Fuel Gauge"
	default y
	depends on DT_HAS_TI_BQ34Z100_ENABLED
	select I2C
	help
	  Enable I2C-based driver for BQ34Z100 Fuel Gauge.

config EMUL_BQ34Z100
	bool "Emulate a BQ34Z100 fuel gauge"
	default y
	depends on EMUL
	depends on BQ34Z100
	help
	  It provides readings which follow a simple sequence, thus allowing
	  test code to check that things are working as expected.
```

## drivers/sensor/ti/bq76952/Kconfig
```kconfig
menuconfig BQ76952
	bool "BQ76952 AFE (sensor driver with controls)"
	default y
	depends on DT_HAS_TI_BQ76952_ENABLED
	select I2C
	help
	  Enable I2C-based driver for BQ76952 AFE

if BQ76952

endif
```

## dts/bindings/fuel-gauge/ti,bq34z100.yaml
```yaml
# Copyright (c) Qualcomm Technologies, Inc. and/or its subsidiaries.
#
# SPDX-License-Identifier: Apache-2.0

description: |
  Texas Instruments BQ34Z100 fuel gauge. For more info visit
  https://www.ti.com/product/BQ34Z100.


compatible: "ti,bq34z100"

include: [i2c-device.yaml, fuel-gauge.yaml]
```

## dts/bindings/rng/nxp,s32-hse-trng.yaml
```yaml
description: NXP S32 HSE TRNG entropy source

compatible: "nxp,s32-hse-trng"

include: base.yaml

properties:
  status:
    required: true
```

## dts/bindings/sensor/ti,opt3002.yaml
```yaml
# Copyright (c) 2019, Actinius
# SPDX-License-Identifier: Apache-2.0

description: Texas Instruments OPT3002 ambient light sensor

compatible: "ti,opt3002"

include: ti,opt300x.yaml
```

## soc/nxp/s32/s32k3/Kconfig.soc
```kconfig
# NXP S32K3XX MCU series

# Copyright 2023-2024 NXP
# SPDX-License-Identifier: Apache-2.0

config SOC_SERIES_S32K3
	bool
	select SOC_FAMILY_NXP_S32

config SOC_SERIES
	default "s32k3" if SOC_SERIES_S32K3

config SOC_S32K344
	bool
	select SOC_SERIES_S32K3

config SOC_S32K311
	bool
	select SOC_SERIES_S32K3

config SOC_S32K312
	bool
	select SOC_SERIES_S32K3

config SOC
	default "s32k344" if SOC_S32K344
	default "s32k311" if SOC_S32K311
	default "s32k312" if SOC_S32K312

config SOC_PART_NUMBER_PS32K344EHVPBS
	bool

config SOC_PART_NUMBER_PS32K311NHT0MPAST
	bool

config SOC_PART_NUMBER_PS32K312NHT0MPAST
	bool

config SOC_PART_NUMBER
	default "PS32K344EHVPBS" if SOC_PART_NUMBER_PS32K344EHVPBS
	default "PS32K311NHT0MPAST" if SOC_PART_NUMBER_PS32K311NHT0MPAST
	default "PS32K312NHT0MPAST" if SOC_PART_NUMBER_PS32K312NHT0MPAST
```
