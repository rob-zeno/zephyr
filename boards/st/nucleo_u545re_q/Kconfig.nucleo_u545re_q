## boards/st/nucleo_u545re_q/Kconfig.nucleo_u545re_q
```kconfig
# Copyright (c) 2021 Linaro Limited
# SPDX-License-Identifier: Apache-2.0

config BOARD_NUCLEO_U545RE_Q
	select SOC_STM32U545XX
```

## soc/st/stm32/stm32u5x/Kconfig.defconfig.stm32u545xx
```kconfig
# ST Microelectronics STM32U545XX MCU

# Copyright (c) 2021 Linaro Limited
# SPDX-License-Identifier: Apache-2.0

if SOC_STM32U545XX

config NUM_IRQS
	default 114

endif # SOC_STM32U545XX
```
